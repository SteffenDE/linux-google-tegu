## Documentation/devicetree/bindings/access-controllers/google,zumapro-s2mpu.yaml
```yaml
# SPDX-License-Identifier: (GPL-2.0-only OR BSD-2-Clause)
%YAML 1.2
---
$id: http://devicetree.org/schemas/access-controllers/google,zumapro-s2mpu.yaml#
$schema: http://devicetree.org/meta-schemas/core.yaml#

title: Google Tensor G4 Stage-2 Memory Protection Unit

maintainers:
  - Steffen Deusch <steffen@deusch.me>

description:
  The S2MPU checks physical memory accesses from a DMA master and its stage-1
  IOMMU. Its protection state is lost when the containing power domain turns
  off. Consumers reference the whole controller through access-controllers.

properties:
  compatible:
    const: google,zumapro-s2mpu

  reg:
    maxItems: 1

  clocks:
    maxItems: 1

  clock-names:
    const: bus

  interrupts:
    maxItems: 1

  power-domains:
    maxItems: 1

  "#access-controller-cells":
    const: 0

required:
  - compatible
  - reg
  - clocks
  - clock-names
  - interrupts
  - power-domains
  - "#access-controller-cells"

additionalProperties: false

examples:
  - |
    #include <dt-bindings/interrupt-controller/arm-gic.h>

    access-controller@1a4a0000 {
        compatible = "google,zumapro-s2mpu";
        reg = <0x1a4a0000 0x10000>;
        clocks = <&cmu_mfc 5>;
        clock-names = "bus";
        interrupts = <GIC_SPI 520 IRQ_TYPE_LEVEL_HIGH>;
        power-domains = <&pd_mfc>;
        #access-controller-cells = <0>;
    };
```

## Documentation/devicetree/bindings/display/google,zumapro-decon.yaml
```yaml
# SPDX-License-Identifier: GPL-2.0-only OR BSD-2-Clause
%YAML 1.2
---
$id: http://devicetree.org/schemas/display/google,zumapro-decon.yaml#
$schema: http://devicetree.org/meta-schemas/core.yaml#

title: Google Tensor G4 Zumapro Display and Enhancement Controller

maintainers:
  - Steffen Trumtrar <s.trumtrar@pengutronix.de>

description:
  The Zumapro DECON block is the display controller used in the Google Tensor
  G4 display pipeline.  It feeds the internal panel through DSIM and uses DPP
  blocks for fetch and composition.

properties:
  compatible:
    const: google,zumapro-decon

  reg:
    minItems: 4
    maxItems: 7

  reg-names:
    minItems: 4
    items:
      - const: main
      - const: win
      - const: sub
      - const: wincon
      - const: dqe
      - const: dqe-cgc
      - const: cgc-dma

  interrupts:
    minItems: 3
    maxItems: 6

  interrupt-names:
    minItems: 3
    maxItems: 6
    oneOf:
      - items:
          - const: frame_start
          - const: frame_done
          - const: extra
      - items:
          - const: frame_start
          - const: frame_done
          - const: extra
          - const: cgc-dma
      - items:
          - const: frame_start
          - const: frame_done
          - const: extra
          - const: dimming_start
          - const: dimming_end
          - const: cgc-dma

  google,decon-id:
    $ref: /schemas/types.yaml#/definitions/uint32
    maximum: 2
    description: DECON instance ID, translated from downstream decon,id.

  google,cgc-dma-id:
    $ref: /schemas/types.yaml#/definitions/uint32
    description: CGC DMA DPP ID, translated from downstream cgc-dma,id.

  google,max-windows:
    $ref: /schemas/types.yaml#/definitions/uint32
    maximum: 14
    description: Maximum hardware windows, translated from downstream max_win.

  iommus:
    minItems: 1
    maxItems: 2

  samsung,iommu-group:
    $ref: /schemas/types.yaml#/definitions/phandle
    description: Shared Samsung System MMU group for DPUF0 and DPUF1.

  samsung,tzmp:
    type: boolean
    description: Downstream flag for TrustZone memory-protection integration.

  power-domains:
    minItems: 1
    maxItems: 2

  dpps:
    $ref: /schemas/types.yaml#/definitions/phandle-array
    items:
      maxItems: 1
    maxItems: 14
    description: DPP blocks available to this DECON.

  ports:
    $ref: /schemas/graph.yaml#/properties/ports
    description: Output port to the DSIM bridge.

required:
  - compatible
  - reg
  - reg-names
  - interrupts
  - interrupt-names
  - google,decon-id

additionalProperties: false

examples:
  - |
    #include <dt-bindings/interrupt-controller/arm-gic.h>

    display-controller@19470000 {
        compatible = "google,zumapro-decon";
        reg = <0x19470000 0x6000>,
              <0x19480000 0xe000>,
              <0x19490000 0x10000>,
              <0x194a0000 0xe000>,
              <0x194d0000 0xf000>,
              <0x194f0000 0x10000>,
              <0x1990e000 0x1000>;
        reg-names = "main", "win", "sub", "wincon", "dqe",
                    "dqe-cgc", "cgc-dma";
        interrupts = <GIC_SPI 243 IRQ_TYPE_LEVEL_HIGH 0>,
                     <GIC_SPI 242 IRQ_TYPE_LEVEL_HIGH 0>,
                     <GIC_SPI 241 IRQ_TYPE_LEVEL_HIGH 0>,
                     <GIC_SPI 240 IRQ_TYPE_LEVEL_HIGH 0>,
                     <GIC_SPI 239 IRQ_TYPE_LEVEL_HIGH 0>,
                     <GIC_SPI 255 IRQ_TYPE_LEVEL_HIGH 0>;
        interrupt-names = "frame_start", "frame_done", "extra",
                          "dimming_start", "dimming_end", "cgc-dma";
        google,decon-id = <0>;
        google,cgc-dma-id = <18>;
        google,max-windows = <14>;

        ports {
            #address-cells = <1>;
            #size-cells = <0>;

            port@0 {
                reg = <0>;

                decon_to_dsi: endpoint {
                    remote-endpoint = <&dsi_from_decon>;
                };
            };
        };
    };

    dsi {
        port {
            dsi_from_decon: endpoint {
                remote-endpoint = <&decon_to_dsi>;
            };
        };
    };
```

## Documentation/devicetree/bindings/display/google,zumapro-dpp.yaml
```yaml
# SPDX-License-Identifier: GPL-2.0-only OR BSD-2-Clause
%YAML 1.2
---
$id: http://devicetree.org/schemas/display/google,zumapro-dpp.yaml#
$schema: http://devicetree.org/meta-schemas/core.yaml#

title: Google Tensor G4 Zumapro Display Pre-Processor

maintainers:
  - Steffen Trumtrar <s.trumtrar@pengutronix.de>

description:
  Zumapro DPP blocks fetch and pre-process framebuffers for the DECON display
  controller.  Early mainline bring-up models these blocks before enabling
  scanout so the DT topology can be validated without touching DPU registers.

properties:
  compatible:
    const: google,zumapro-dpp

  reg:
    minItems: 6
    maxItems: 6

  reg-names:
    items:
      - const: dma
      - const: dpp
      - const: scl_coef
      - const: sramc
      - const: hdr_comm
      - const: hdr

  interrupts:
    minItems: 2
    maxItems: 2

  interrupt-names:
    items:
      - const: dma
      - const: dpp

  google,dpp-id:
    $ref: /schemas/types.yaml#/definitions/uint32
    maximum: 13
    description: DPP instance ID, translated from downstream dpp,id.

  google,video-formats:
    type: boolean
    description: The DPP can fetch video formats in addition to RGB formats.

  google,dpp-attributes:
    $ref: /schemas/types.yaml#/definitions/uint32
    description: DPP attribute bitmask, translated from downstream attr.

  google,axi-port:
    $ref: /schemas/types.yaml#/definitions/uint32
    description: DPUF AXI port index, translated from downstream port.

  google,scale-down:
    $ref: /schemas/types.yaml#/definitions/uint32
    description: Maximum scale-down factor, translated from downstream scale_down.

  google,scale-up:
    $ref: /schemas/types.yaml#/definitions/uint32
    description: Maximum scale-up factor, translated from downstream scale_up.

required:
  - compatible
  - reg
  - reg-names
  - interrupts
  - interrupt-names
  - google,dpp-id

additionalProperties: false

examples:
  - |
    #include <dt-bindings/interrupt-controller/arm-gic.h>

    dpp@19900000 {
        compatible = "google,zumapro-dpp";
        reg = <0x19900000 0x1000>,
              <0x19930000 0x1000>,
              <0x19940000 0x4000>,
              <0x19950000 0x1000>,
              <0x19960000 0x1000>,
              <0x19980000 0x1000>;
        reg-names = "dma", "dpp", "scl_coef", "sramc", "hdr_comm", "hdr";
        interrupts = <GIC_SPI 256 IRQ_TYPE_LEVEL_HIGH 0>,
                     <GIC_SPI 265 IRQ_TYPE_LEVEL_HIGH 0>;
        interrupt-names = "dma", "dpp";
        google,dpp-attributes = <0x6d0867>;
        google,axi-port = <0>;
        google,scale-down = <4>;
        google,scale-up = <8>;
        google,dpp-id = <0>;
    };
```

## Documentation/devicetree/bindings/display/panel/google,gs-tg4c.yaml
```yaml
# SPDX-License-Identifier: GPL-2.0-only OR BSD-2-Clause
%YAML 1.2
---
$id: http://devicetree.org/schemas/display/panel/google,gs-tg4c.yaml#
$schema: http://devicetree.org/meta-schemas/core.yaml#

title: Google GS TG4C 1080x2424 MIPI-DSI Panel

maintainers:
  - Steffen Deusch <steffen@deusch.me>

description:
  The Google GS TG4C is a command-mode AMOLED panel used in the Google
  Pixel 9a. It uses four MIPI-DSI data lanes and Display Stream Compression.

allOf:
  - $ref: panel-common.yaml#

properties:
  compatible:
    const: google,gs-tg4c

  reg:
    maxItems: 1

  reset-gpios:
    maxItems: 1
    description: Active-high panel reset GPIO.

  vci-supply:
    description: Analog panel supply.

  vddi-supply:
    description: Panel I/O supply.

  vddd-supply:
    description: Panel core supply.

  port: true

required:
  - compatible
  - reg
  - reset-gpios
  - vci-supply
  - vddi-supply
  - vddd-supply
  - port

additionalProperties: false

examples:
  - |
    #include <dt-bindings/gpio/gpio.h>

    dsi {
        #address-cells = <1>;
        #size-cells = <0>;

        panel@0 {
            compatible = "google,gs-tg4c";
            reg = <0>;

            reset-gpios = <&gpp0 0 GPIO_ACTIVE_HIGH>;
            vci-supply = <&m_ldo14_reg>;
            vddi-supply = <&s_bucka_reg>;
            vddd-supply = <&disp_vddd>;

            port {
                panel_in: endpoint {
                    remote-endpoint = <&dsi_out>;
                };
            };
        };
    };

...
```

## Documentation/devicetree/bindings/gnss/samsung,kepler.yaml
```yaml
# SPDX-License-Identifier: GPL-2.0-only OR BSD-2-Clause
%YAML 1.2
---
$id: http://devicetree.org/schemas/gnss/samsung,kepler.yaml#
$schema: http://devicetree.org/meta-schemas/core.yaml#

title: Samsung KEPLER GNSS receiver

maintainers:
  - Steffen Deusch <steffen@deusch.me>

description:
  KEPLER is the GNSS receiver integrated alongside the Exynos baseband on
  Google Tensor SoCs. Its firmware is staged into the baseband's shared
  memory and started by the baseband, but the runtime host link is an
  independent SPI bus with a two-wire handshake, which is what this binding
  describes.

allOf:
  - $ref: /schemas/spi/spi-peripheral-props.yaml#

properties:
  compatible:
    const: samsung,kepler

  reg:
    maxItems: 1

  gnss2ap-gpios:
    maxItems: 1
    description:
      Device to host. Driven high while the receiver has data to move, and,
      during a host-initiated write, once it is ready to accept the transfer.
      Also the interrupt source, which is level triggered.

  ap2gnss-gpios:
    maxItems: 1
    description:
      Host to device. Driven high to tell the receiver the host is ready to
      move data, either to take a burst or to begin a write.

required:
  - compatible
  - reg
  - gnss2ap-gpios
  - ap2gnss-gpios

unevaluatedProperties: false

examples:
  - |
    #include <dt-bindings/gpio/gpio.h>

    spi {
        #address-cells = <1>;
        #size-cells = <0>;

        gnss@0 {
            compatible = "samsung,kepler";
            reg = <0>;
            spi-max-frequency = <3125000>;
            gnss2ap-gpios = <&gpa5 4 GPIO_ACTIVE_HIGH>;
            ap2gnss-gpios = <&gpp2 3 GPIO_ACTIVE_HIGH>;
        };
    };
```

## Documentation/devicetree/bindings/gpio/samsung,s2mpg14-gpio.yaml
```yaml
# SPDX-License-Identifier: GPL-2.0-only OR BSD-2-Clause
%YAML 1.2
---
$id: http://devicetree.org/schemas/gpio/samsung,s2mpg14-gpio.yaml#
$schema: http://devicetree.org/meta-schemas/core.yaml#

title: Samsung S2MPG14/S2MPG15 PMIC GPIO controller

maintainers:
  - Steffen Deusch <steffen@deusch.me>

description:
  General-purpose pins on the Samsung S2MPG14 and S2MPG15 PMICs. This is a
  child node of the PMIC, which is itself reached over the ACPM mailbox.
  The S2MPG14 has six pins and the S2MPG15 ten.

properties:
  compatible:
    enum:
      - samsung,s2mpg14-gpio
      - samsung,s2mpg15-gpio

  gpio-controller: true

  "#gpio-cells":
    const: 2

  gpio-line-names: true

required:
  - compatible
  - gpio-controller
  - "#gpio-cells"

additionalProperties: false

examples:
  - |
    pmic {
        gpio {
            compatible = "samsung,s2mpg14-gpio";
            gpio-controller;
            #gpio-cells = <2>;
        };
    };
```

## Documentation/devicetree/bindings/interconnect/google,zumapro-bts.yaml
```yaml
# SPDX-License-Identifier: (GPL-2.0-only OR BSD-2-Clause)
%YAML 1.2
---
$id: http://devicetree.org/schemas/interconnect/google,zumapro-bts.yaml#
$schema: http://devicetree.org/meta-schemas/core.yaml#

title: Google Zumapro Bus Traffic Shaper

maintainers:
  - Steffen Deusch <steffen@deusch.me>

description: |
  The Samsung Bus Traffic Shaper (BTS) in Google's Zumapro SoC controls AXI
  quality of service at individual NoC masters and translates aggregate client
  bandwidth into minimum MIF and INT ACPM DVFS rates.

  The register resources describe the BTS blocks managed by this provider.
  These cover the MFC, ISPFE, DPU and G2D ports. Client bandwidth and workload
  tags select per-master clock floors and outstanding-transaction profiles.

properties:
  compatible:
    const: google,zumapro-bts

  reg:
    items:
      - description: MFC channel 0 BTS registers
      - description: MFC channel 1 BTS registers
      - description: DPU channel 0 BTS registers
      - description: DPU channel 1 BTS registers
      - description: ISPFE channel 0 BTS registers
      - description: ISPFE channel 1 BTS registers
      - description: ISPFE channel 2 BTS registers
      - description: ISPFE channel 3 BTS registers
      - description: G2D channel 0 BTS registers
      - description: G2D channel 1 BTS registers
      - description: G2D channel 2 BTS registers

  reg-names:
    items:
      - const: mfc0
      - const: mfc1
      - const: dpu0
      - const: dpu1
      - const: ispfe0
      - const: ispfe1
      - const: ispfe2
      - const: ispfe3
      - const: g2d0
      - const: g2d1
      - const: g2d2

  clocks:
    items:
      - description: MIF ACPM DVFS domain
      - description: INT ACPM DVFS domain

  clock-names:
    items:
      - const: mif
      - const: int

  '#interconnect-cells':
    const: 1

required:
  - compatible
  - reg
  - reg-names
  - clocks
  - clock-names
  - '#interconnect-cells'

additionalProperties: false

examples:
  - |
    #include <dt-bindings/clock/google,zumapro-acpm.h>

    interconnect@26c48380 {
        compatible = "google,zumapro-bts";
        reg = <0x26c48380 0x80>, <0x26c48400 0x80>,
              <0x26c48000 0x80>,
              <0x26c48080 0x80>,
              <0x26c48180 0x80>,
              <0x26c48200 0x80>,
              <0x26c48280 0x80>,
              <0x26c48300 0x80>,
              <0x27048200 0x80>,
              <0x27048280 0x80>,
              <0x27048300 0x80>;
        reg-names = "mfc0", "mfc1", "dpu0", "dpu1", "ispfe0",
                    "ispfe1", "ispfe2", "ispfe3", "g2d0", "g2d1", "g2d2";
        clocks = <&acpm_ipc ZUMAPRO_CLK_ACPM_DVFS_MIF>,
                 <&acpm_ipc ZUMAPRO_CLK_ACPM_DVFS_INT>;
        clock-names = "mif", "int";
        #interconnect-cells = <1>;
    };
```
