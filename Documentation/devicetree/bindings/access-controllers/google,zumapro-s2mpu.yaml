## Documentation/devicetree/bindings/iommu/samsung,sysmmu-group.yaml
```yaml
# SPDX-License-Identifier: GPL-2.0-only OR BSD-2-Clause
%YAML 1.2
---
$id: http://devicetree.org/schemas/iommu/samsung,sysmmu-group.yaml#
$schema: http://devicetree.org/meta-schemas/core.yaml#

title: Samsung System MMU group

maintainers:
  - Marek Szyprowski <m.szyprowski@samsung.com>

description:
  Samsung System MMU group nodes describe a shared IOMMU translation domain
  used by devices with more than one System MMU controller.

properties:
  compatible:
    const: samsung,sysmmu-group

required:
  - compatible

additionalProperties: false

examples:
  - |
    iommu-group-dpu {
        compatible = "samsung,sysmmu-group";
    };
```

## Documentation/devicetree/bindings/iommu/samsung,sysmmu-v9.yaml
```yaml
# SPDX-License-Identifier: GPL-2.0-only OR BSD-2-Clause
%YAML 1.2
---
$id: http://devicetree.org/schemas/iommu/samsung,sysmmu-v9.yaml#
$schema: http://devicetree.org/meta-schemas/core.yaml#

title: Samsung System MMU v9

maintainers:
  - Marek Szyprowski <m.szyprowski@samsung.com>

description:
  Samsung System MMU v9 is the IOMMU generation used by later Exynos and Google
  Tensor display, multimedia, and accelerator blocks.  It is not register
  compatible with the older samsung,exynos-sysmmu controller.

properties:
  compatible:
    const: samsung,sysmmu-v9

  reg:
    maxItems: 1

  interrupts:
    minItems: 1
    maxItems: 2

  "#iommu-cells":
    const: 0

  power-domains:
    maxItems: 1

  samsung,qos:
    $ref: /schemas/types.yaml#/definitions/uint32
    description: Downstream QoS priority programmed by the v9 driver.
    maximum: 15

  samsung,secure-irq:
    type: boolean
    description: The controller has a second interrupt for secure faults.

  samsung,secure-base:
    $ref: /schemas/types.yaml#/definitions/uint32
    description: Secure fault register base used by the downstream v9 driver.

  samsung,port-name:
    $ref: /schemas/types.yaml#/definitions/string
    description: Human-readable hardware port name used in fault reports.

patternProperties:
  "^samsung,pmmu[0-7]-default-stream$":
    $ref: /schemas/types.yaml#/definitions/uint32
    description: Default stream configuration word for one PMMU instance.

  "^samsung,pmmu[0-7]-stream-property$":
    $ref: /schemas/types.yaml#/definitions/uint32-array
    description: |
      Stream table entries for one PMMU instance.  Each entry is five cells:
      stream table index, stream configuration, match configuration, stream ID
      value, and stream ID mask.
    minItems: 5
    maxItems: 512

required:
  - compatible
  - reg
  - interrupts
  - "#iommu-cells"

additionalProperties: false

examples:
  - |
    #include <dt-bindings/interrupt-controller/arm-gic.h>

    iommu@19840000 {
        compatible = "samsung,sysmmu-v9";
        reg = <0x19840000 0x10000>;
        interrupts = <GIC_SPI 277 IRQ_TYPE_LEVEL_HIGH 0>,
                     <GIC_SPI 278 IRQ_TYPE_LEVEL_HIGH 0>;
        samsung,qos = <15>;
        samsung,secure-irq;
        samsung,secure-base = <0x19850000>;
        samsung,port-name = "DPU F0";
        samsung,pmmu0-default-stream = <0x600014a>;
        samsung,pmmu1-default-stream = <0x800014a>;
        #iommu-cells = <0>;
    };
```

## Documentation/devicetree/bindings/media/google,zumapro-becore.yaml
```yaml
# SPDX-License-Identifier: (GPL-2.0-only OR BSD-2-Clause)
%YAML 1.2
---
$id: http://devicetree.org/schemas/media/google,zumapro-becore.yaml#
$schema: http://devicetree.org/meta-schemas/core.yaml#

title: Google Zumapro camera back-end core

maintainers:
  - Steffen Deusch <steffen@deusch.me>

description:
  The Zumapro camera back-end pipeline contains the RGBP Bayer and RGB
  processor, the optional MCFP multi-frame processor, the YUVP YUV processor,
  and the MCSC final scaler.  RGBP, YUVP and MCSC have separate power domains;
  MCFP resides in the RGBP domain.  The RGBP command loader resides in the GDC
  power domain, which is consequently a dependency even when GDC receives no
  per-frame program.

  Each processor that owns an endpoint of the VOTF fabric -- which carries a
  frame between two blocks in line-sized tokens rather than through a full-frame
  buffer in DRAM -- also owns a C2SERV register window, located in that
  processor's own power domain.

properties:
  compatible:
    const: google,zumapro-becore

  reg:
    items:
      - description: RGBP processor
      - description: MCFP processor
      - description: YUVP processor
      - description: RGBP system memory stream-attribute mapper
      - description: YUVP system memory stream-attribute mapper
      - description: RGBP system register controlling internal routing
      - description: MCFP system memory stream-attribute mapper D0
      - description: MCFP system memory stream-attribute mapper D1
      - description: MCFP system memory stream-attribute mapper D2
      - description: MCFP system memory stream-attribute mapper D3
      - description: MCFP system memory stream-attribute mapper D4
      - description: MCSC processor
      - description: MCSC system memory stream-attribute mapper D0
      - description: MCSC system memory stream-attribute mapper D1
      - description: MCSC system memory stream-attribute mapper D2
      - description: MCSC system memory stream-attribute mapper D3
      - description: MCSC system memory stream-attribute mapper D4
      - description: MCSC system memory stream-attribute mapper D5
      - description: MCSC system memory stream-attribute mapper D6
      - description: MCSC system register controlling internal routing
      - description: RGBP VOTF C2SERV instance
      - description: YUVP VOTF C2SERV instance
      - description: MCSC VOTF C2SERV instance

  reg-names:
    items:
      - const: rgbp
      - const: mcfp
      - const: yuvp
      - const: ssmt-rgbp
      - const: ssmt-yuvp
      - const: sysreg-rgbp
      - const: ssmt-mcfp0
      - const: ssmt-mcfp1
      - const: ssmt-mcfp2
      - const: ssmt-mcfp3
      - const: ssmt-mcfp4
      - const: mcsc
      - const: ssmt-mcsc0
      - const: ssmt-mcsc1
      - const: ssmt-mcsc2
      - const: ssmt-mcsc3
      - const: ssmt-mcsc4
      - const: ssmt-mcsc5
      - const: ssmt-mcsc6
      - const: sysreg-mcsc
      - const: rgbp-c2serv
      - const: yuvp-c2serv
      - const: mcsc-c2serv

  interrupts:
    items:
      - description: RGBP processing and command queue interrupt
      - description: RGBP secondary interrupt
      - description: MCFP processing and command queue interrupt
      - description: MCFP secondary interrupt
      - description: YUVP processing and command queue interrupt
      - description: YUVP secondary interrupt
      - description: MCSC processing and command queue interrupt
      - description: MCSC secondary interrupt

  interrupt-names:
    items:
      - const: rgbp-int0
      - const: rgbp-int1
      - const: mcfp-int0
      - const: mcfp-int1
      - const: yuvp-int0
      - const: yuvp-int1
      - const: mcsc-int0
      - const: mcsc-int1

  power-domains:
    items:
      - description: YUVP power domain
      - description: RGBP and MCFP power domain
      - description: GDC power domain containing the RGBP command loader
      - description: MCSC power domain

  power-domain-names:
    items:
      - const: yuvp
      - const: rgbp
      - const: gdc
      - const: mcsc

  clocks:
    maxItems: 1
    description:
      INTCAM ACPM DVFS domain.  RGBP, MCFP, YUVP, GDC and MCSC all belong to
      it, so one request covers the whole back end.

  clock-names:
    items:
      - const: intcam

  iommus:
    items:
      - description: YUVP System MMU
      - description: RGBP System MMU S0
      - description: RGBP System MMU S1
      - description: GDC System MMU used by the RGBP command loader
      - description: MCSC System MMU

  samsung,iommu-group:
    $ref: /schemas/types.yaml#/definitions/phandle
    description:
      Shared IOMMU group object used by the Samsung System MMU v9 driver.

  samsung,iommu-identity-map:
    $ref: /schemas/types.yaml#/definitions/uint32-matrix
    minItems: 1
    maxItems: 8
    items:
      minItems: 3
      maxItems: 3
    description:
      Regions that have to be mapped one-to-one in this device's IOMMU domain,
      each a 64-bit address followed by a 32-bit size.  Both must be a whole
      number of pages.  A VOTF producer signals its consumer by writing to a
      register inside the consumer's C2SERV window, at an address the hardware
      derives from the consumer's IP ID rather than one anybody allocated, and
      that write reaches the System MMU as ordinary DMA.

required:
  - compatible
  - reg
  - reg-names
  - interrupts
  - interrupt-names
  - power-domains
  - power-domain-names
  - clocks
  - clock-names
  - iommus
  - samsung,iommu-group

additionalProperties: false

examples:
  - |
    #include <dt-bindings/clock/google,zumapro-acpm.h>
    #include <dt-bindings/interrupt-controller/arm-gic.h>

    camera@1c440000 {
        compatible = "google,zumapro-becore";
        reg = <0x1c440000 0x10000>,
              <0x1c470000 0x10000>,
              <0x1c840000 0x10000>,
              <0x1c5d4000 0xe00>,
              <0x1c914000 0xe00>,
              <0x1c420404 0x4>,
              <0x1c604000 0xe00>,
              <0x1c614000 0xe00>,
              <0x1c624000 0xe00>,
              <0x1c634000 0xe00>,
              <0x1c644000 0xe00>,
              <0x1d040000 0x10000>,
              <0x1d104000 0xe00>,
              <0x1d114000 0xe00>,
              <0x1d124000 0xe00>,
              <0x1d134000 0xe00>,
              <0x1d144000 0xe00>,
              <0x1d154000 0xe00>,
              <0x1d164000 0xe00>,
              <0x1d020400 0x4>,
              <0x1c460000 0x10000>,
              <0x1c860000 0x10000>,
              <0x1d050000 0x10000>;
        reg-names = "rgbp", "mcfp", "yuvp", "ssmt-rgbp", "ssmt-yuvp",
                    "sysreg-rgbp", "ssmt-mcfp0", "ssmt-mcfp1",
                    "ssmt-mcfp2", "ssmt-mcfp3", "ssmt-mcfp4", "mcsc",
                    "ssmt-mcsc0", "ssmt-mcsc1", "ssmt-mcsc2",
                    "ssmt-mcsc3", "ssmt-mcsc4", "ssmt-mcsc5",
                    "ssmt-mcsc6", "sysreg-mcsc", "rgbp-c2serv",
                    "yuvp-c2serv", "mcsc-c2serv";
        interrupts = <GIC_SPI 673 IRQ_TYPE_LEVEL_HIGH 0>,
                     <GIC_SPI 674 IRQ_TYPE_LEVEL_HIGH 0>,
                     <GIC_SPI 663 IRQ_TYPE_LEVEL_HIGH 0>,
                     <GIC_SPI 664 IRQ_TYPE_LEVEL_HIGH 0>,
                     <GIC_SPI 744 IRQ_TYPE_LEVEL_HIGH 0>,
                     <GIC_SPI 745 IRQ_TYPE_LEVEL_HIGH 0>,
                     <GIC_SPI 502 IRQ_TYPE_LEVEL_HIGH 0>,
                     <GIC_SPI 503 IRQ_TYPE_LEVEL_HIGH 0>;
        interrupt-names = "rgbp-int0", "rgbp-int1",
                          "mcfp-int0", "mcfp-int1",
                          "yuvp-int0", "yuvp-int1",
                          "mcsc-int0", "mcsc-int1";
        power-domains = <&pd_yuvp>, <&pd_rgbp>, <&pd_gdc>, <&pd_mcsc>;
        power-domain-names = "yuvp", "rgbp", "gdc", "mcsc";
        clocks = <&acpm_ipc ZUMAPRO_CLK_ACPM_DVFS_INTCAM>;
        clock-names = "intcam";
        iommus = <&sysmmu_yuvp>, <&sysmmu_rgbp_s0>, <&sysmmu_rgbp_s1>,
                 <&sysmmu_gdc>, <&sysmmu_mcsc>;
        samsung,iommu-group = <&iommu_group_isp>;
        samsung,iommu-identity-map = <0x0 0x1c86d000 0x3000>,
                                     <0x0 0x1d05d000 0x3000>;
    };
...
```
