## Documentation/devicetree/bindings/soc/samsung/google,zumapro-s2mpu.yaml
```yaml
# SPDX-License-Identifier: (GPL-2.0-only OR BSD-2-Clause)
%YAML 1.2
---
$id: http://devicetree.org/schemas/soc/samsung/google,zumapro-s2mpu.yaml#
$schema: http://devicetree.org/meta-schemas/core.yaml#

title: Google Tensor (zumapro) Stage-2 Memory Protection Unit

maintainers:
  - Steffen Deusch <steffen@deusch.me>

description:
  An S2MPU sits between a DMA master and the system bus and blocks all of that
  master's DMA traffic after reset until its memory-protection table is
  programmed. On Google Tensor (zumapro) SoCs there is one S2MPU instance per
  DMA master, each in the master's power domain, and each returns to the
  all-blocked reset state whenever that domain is powered off.

properties:
  compatible:
    const: google,zumapro-s2mpu

  reg:
    maxItems: 1

  interrupts:
    maxItems: 1
    description: Permission-fault interrupt.

  power-domains:
    maxItems: 1

required:
  - compatible
  - reg
  - power-domains

additionalProperties: false

examples:
  - |
    #include <dt-bindings/interrupt-controller/arm-gic.h>

    iommu@1ee70000 {
        compatible = "google,zumapro-s2mpu";
        reg = <0x1ee70000 0x10000>;
        interrupts = <GIC_SPI 354 IRQ_TYPE_LEVEL_HIGH>;
        power-domains = <&pd_g3d>;
    };
```

## arch/arm64/Kconfig.debug
```kconfig
# SPDX-License-Identifier: GPL-2.0-only

config PID_IN_CONTEXTIDR
	bool "Write the current PID to the CONTEXTIDR register"
	help
	  Enabling this option causes the kernel to write the current PID to
	  the CONTEXTIDR register, at the expense of some additional
	  instructions during context switch. Say Y here only if you are
	  planning to use hardware trace tools with this kernel.

config DEBUG_EFI
	depends on EFI && DEBUG_INFO
	bool "UEFI debugging"
	help
	  Enable this option to include EFI specific debugging features into
	  the kernel that are only useful when using a debug build of the
	  UEFI firmware

config ARM64_RELOC_TEST
	depends on m
	tristate "Relocation testing module"

source "drivers/hwtracing/coresight/Kconfig"

config ARM64_RESUME_ENTRY_RESET_PROBE
	bool "DIAGNOSTIC: reset the machine at the suspend resume entry point"
	help
	  Reset the machine from the first instruction of cpu_resume, before
	  the MMU, the stack or any DRAM access.  The reboot is then the only
	  signal needed to prove the firmware brought the AP back, on a machine
	  where suspend-to-RAM goes down and never returns and every later
	  probe depends on state that may not have survived.

	  This makes suspend-to-RAM and every power-down idle state reset the
	  machine, so a kernel built with it is good for one measurement and
	  nothing else.  Boot it with cpuidle.off=1 so the resume entry is
	  reached only by suspend-to-RAM.

	  If unsure, say N.
```

## drivers/gnss/Kconfig
```kconfig
# SPDX-License-Identifier: GPL-2.0-only
#
# GNSS receiver configuration
#

menuconfig GNSS
	tristate "GNSS receiver support"
	help
	  Say Y here if you have a GNSS receiver (e.g. a GPS receiver).

	  To compile this driver as a module, choose M here: the module will
	  be called gnss.

if GNSS

config GNSS_SERIAL
	tristate

config GNSS_MTK_SERIAL
	tristate "Mediatek GNSS receiver support"
	depends on SERIAL_DEV_BUS
	select GNSS_SERIAL
	help
	  Say Y here if you have a Mediatek-based GNSS receiver which uses a
	  serial interface.

	  To compile this driver as a module, choose M here: the module will
	  be called gnss-mtk.

	  If unsure, say N.

config GNSS_SIRF_SERIAL
	tristate "SiRFstar GNSS receiver support"
	depends on SERIAL_DEV_BUS
	help
	  Say Y here if you have a SiRFstar-based GNSS receiver which uses a
	  serial interface.

	  To compile this driver as a module, choose M here: the module will
	  be called gnss-sirf.

	  If unsure, say N.

config GNSS_UBX_SERIAL
	tristate "u-blox GNSS receiver support"
	depends on SERIAL_DEV_BUS
	select GNSS_SERIAL
	help
	  Say Y here if you have a u-blox GNSS receiver which uses a serial
	  interface.

	  To compile this driver as a module, choose M here: the module will
	  be called gnss-ubx.

	  If unsure, say N.

config GNSS_KEPLER
	tristate "Samsung KEPLER GNSS receiver support"
	depends on SPI
	depends on OF || COMPILE_TEST
	help
	  Say Y here if you have a Samsung KEPLER GNSS receiver, as integrated
	  alongside the Exynos baseband on Google Tensor SoCs. Its firmware is
	  started by the baseband; this driver is only the SPI transport that
	  carries the receiver's stream to user space.

	  To compile this driver as a module, choose M here: the module will
	  be called gnss-kepler.

	  If unsure, say N.

config GNSS_USB
	tristate "USB GNSS receiver support"
	depends on USB
	help
	  Say Y here if you have a GNSS receiver which uses a USB interface.

	  To compile this driver as a module, choose M here: the module will
	  be called gnss-usb.

	  If unsure, say N.

endif # GNSS
```

## drivers/iio/common/aoc_usf/Kconfig
```kconfig
# SPDX-License-Identifier: GPL-2.0-only
config AOC_USF_IIO
	tristate "AoC USF sensor framework to IIO bridge"
	depends on IIO
	depends on AOC_CHAN_DRIVER
	select AOC_USF_CORE
	select IIO_BUFFER
	select IIO_KFIFO_BUF
	help
	  Bridge the sensors hosted by the AoC USF (Unified Sensor Framework)
	  firmware on Google Tensor devices to Linux IIO. The AoC sensor
	  registry is loaded out of band by a userspace daemon; once it is
	  loaded, this driver enumerates the sensors over the com.google.usf
	  AOCC channel and exposes them as IIO devices (accelerometer,
	  gyroscope, magnetometer, light, proximity, pressure).

	  To compile this driver as a module, choose M here: the module will
	  be called aoc-usf-iio.

	  If unsure, say N.
```

## drivers/media/platform/samsung/exynos-becore/Kconfig
```kconfig
# SPDX-License-Identifier: GPL-2.0-only

config VIDEO_EXYNOS_BECORE
	bool "Google zumapro camera back-end core"
	depends on ARCH_EXYNOS || COMPILE_TEST
	depends on OF
	depends on PM
	depends on VIDEO_DEV
	select MEDIA_CONTROLLER
	select VIDEOBUF2_DMA_CONTIG
	help
	  Bring-up driver for the RGBP, MCFP and YUVP image processors in
	  Google's zumapro (Tensor G4) camera back end.

	  The driver restores the three power-domain dependencies, resets and
	  initializes the processors, and handles their interrupts.  It exposes a
	  fixed P010 capture queue for processed diagnostic frames.  Debugfs can
	  upload one validated RGBP/YUVP command recipe, compressed Bayer input and
	  YUVP statistics grid, then execute one offline frame into a driver-owned
	  output allocation; that upload path is a bring-up oracle, not a userspace
	  camera ABI.

	  This is built-in because removal cannot be aborted if a processor fails
	  to reset before its power domains are switched off.

	  If unsure, say N.
```
