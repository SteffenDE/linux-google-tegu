## Documentation/devicetree/bindings/misc/linux,mmio-init-helper.yaml
```yaml
# SPDX-License-Identifier: GPL-2.0-only OR BSD-2-Clause
%YAML 1.2
---
$id: http://devicetree.org/schemas/misc/linux,mmio-init-helper.yaml#
$schema: http://devicetree.org/meta-schemas/core.yaml#

title: Linux MMIO Init Helper

maintainers:
  - Steffen Deuchler <steffen@deusch.me>

description:
  Temporary helper for early platform bring-up. The helper maps one 32-bit
  MMIO register and writes a fixed value once when the platform device probes.
  If mask is present, the helper performs a read-modify-write using
  (old & ~mask) | (value & mask).

properties:
  compatible:
    const: linux,mmio-init-helper

  reg:
    maxItems: 1

  value:
    $ref: /schemas/types.yaml#/definitions/uint32
    description: Value to write to the MMIO register, or masked value.

  mask:
    $ref: /schemas/types.yaml#/definitions/uint32
    description: Optional bit mask for read-modify-write updates.

required:
  - compatible
  - reg
  - value

additionalProperties: false

examples:
  - |
    / {
        #address-cells = <2>;
        #size-cells = <1>;

        mmio-init@19470030 {
            compatible = "linux,mmio-init-helper";
            reg = <0x0 0x19470030 0x4>;
            value = <0x3061>;
        };

        mmio-init@19470034 {
            compatible = "linux,mmio-init-helper";
            reg = <0x0 0x19470034 0x4>;
            mask = <0x11>;
            value = <0x01>;
        };
    };

...
```

## Documentation/devicetree/bindings/nvmem/maxim,max77779sp.yaml
```yaml
# SPDX-License-Identifier: GPL-2.0-only OR BSD-2-Clause
%YAML 1.2
---
$id: http://devicetree.org/schemas/nvmem/maxim,max77779sp.yaml#
$schema: http://devicetree.org/meta-schemas/core.yaml#

title: Maxim MAX77779 battery-backed scratchpad

maintainers:
  - Steffen Deusch <steffen@deusch.me>

description:
  The MAX77779 PMIC integrates a battery-backed scratchpad that is reachable as
  an independent I2C device (default address 0x60). Its contents survive a
  reset, and a power cut, for as long as the battery stays connected, and the
  bootloader uses the start of it to exchange the reboot mode and reason with
  the kernel. This binding describes the scratchpad function only. Four
  256-byte pages exist; the first, which is the one shared with the bootloader,
  is what the driver exposes.

allOf:
  - $ref: nvmem.yaml#

properties:
  compatible:
    const: maxim,max77779sp

  reg:
    maxItems: 1

required:
  - compatible
  - reg

unevaluatedProperties: false

examples:
  - |
    i2c {
        #address-cells = <1>;
        #size-cells = <0>;

        nvmem@60 {
            compatible = "maxim,max77779sp";
            reg = <0x60>;

            nvmem-layout {
                compatible = "fixed-layout";
                #address-cells = <1>;
                #size-cells = <1>;

                reboot-mode@0 {
                    reg = <0x0 0x4>;
                };
            };
        };
    };
```

## Documentation/devicetree/bindings/pci/google,zumapro-pcie.yaml
```yaml
# SPDX-License-Identifier: (GPL-2.0-only OR BSD-2-Clause)
%YAML 1.2
---
$id: http://devicetree.org/schemas/pci/google,zumapro-pcie.yaml#
$schema: http://devicetree.org/meta-schemas/core.yaml#

title: Google Zumapro (Tensor G4) PCIe Root Complex

maintainers:
  - Steffen Deusch <steffen@deusch.me>

description:
  PCIe root complexes of the Google Zumapro (Tensor G4) SoC, based on the
  Synopsys DesignWare PCIe IP, inheriting the common properties from
  snps,dw-pcie.yaml.  The GEN3A_1 controller on HSI2 (x1) serves the on-board
  WiFi; the GEN3_0 controller on HSI1 (x2) serves the Exynos modem.

allOf:
  - $ref: /schemas/pci/snps,dw-pcie.yaml#

properties:
  compatible:
    const: google,zumapro-pcie

  reg:
    items:
      - description: External Local Bus Interface (ELBI/app) registers
      - description: Data Bus Interface (DBI) registers
      - description: PCIe configuration space region

  reg-names:
    items:
      - const: elbi
      - const: dbi
      - const: config

  interrupts:
    items:
      - description: PCIe controller (link/INTx) interrupt
      - description: MSI interrupt

  interrupt-names:
    items:
      - const: intr
      - const: msi

  clocks:
    items:
      - description: DBI access clock
      - description: AXI master (outbound) clock
      - description: AXI slave (inbound) clock
      - description: controller APB clock

  clock-names:
    items:
      - const: dbi
      - const: mstr
      - const: slv
      - const: apb

  phys:
    maxItems: 1

  phy-names:
    items:
      - const: pcie

  reset-gpios:
    maxItems: 1
    description: PERST# reset line to the endpoint.

  samsung,pmu-syscon:
    $ref: /schemas/types.yaml#/definitions/phandle-array
    maxItems: 1
    items:
      minItems: 2
      items:
        - description: phandle to the PMU system controller
        - description: offset of the PCIE wakeup control register
    description:
      Phandle/offset pair for the PMU register controlling the PCIe block.

  num-lanes:
    enum: [1, 2]

  google,cp-pwr-gpios:
    maxItems: 1
    description: CP (modem) power-on line (AP2CP_CP_PWR_ON).

  google,cp-pda-active-gpios:
    maxItems: 1
    description: CP PDA_ACTIVE handshake line.

  google,cp-wakeup-gpios:
    maxItems: 1
    description: AP2CP wakeup line.

  google,cp-pm-wrst-gpios:
    maxItems: 1
    description: CP PMIC warm-reset line (raw level, deasserted high).

  google,cp-nreset-gpios:
    maxItems: 1
    description: CP reset line (raw level, deasserted high).

  google,cp-wrst-gpios:
    maxItems: 1
    description: CP warm-reset line (raw level, deasserted high).

dependentRequired:
  # Bring-up scaffolding for the modem endpoint on the HSI1 controller: the
  # root complex sequences the CP rails before link training so the modem
  # mask-ROM enumerates.  Moves to the modem-control driver once one exists.
  google,cp-pwr-gpios:
    - google,cp-pda-active-gpios
    - google,cp-wakeup-gpios
    - google,cp-pm-wrst-gpios
    - google,cp-nreset-gpios
    - google,cp-wrst-gpios

required:
  - compatible
  - reg
  - reg-names
  - interrupts
  - interrupt-names
  - "#address-cells"
  - "#size-cells"
  - "#interrupt-cells"
  - ranges
  - bus-range
  - device_type
  - num-lanes
  - max-link-speed
  - clocks
  - clock-names
  - phys
  - phy-names
  - reset-gpios

unevaluatedProperties: false

examples:
  - |
    #include <dt-bindings/interrupt-controller/irq.h>
    #include <dt-bindings/interrupt-controller/arm-gic.h>
    #include <dt-bindings/clock/google,zumapro.h>
    #include <dt-bindings/gpio/gpio.h>

    pcie@13120000 {
        compatible = "google,zumapro-pcie";
        reg = <0x13120000 0x2000>,
              <0x13400000 0x381000>,
              <0x60ffe000 0x2000>;
        reg-names = "elbi", "dbi", "config";
        #address-cells = <3>;
        #size-cells = <2>;
        #interrupt-cells = <1>;
        device_type = "pci";
        interrupts = <GIC_SPI 439 IRQ_TYPE_LEVEL_HIGH>,
                     <GIC_SPI 441 IRQ_TYPE_LEVEL_HIGH>;
        interrupt-names = "intr", "msi";
        clocks = <&cmu_hsi2 CLK_GOUT_HSI2_PCIE_GEN3A_1_DBI_ACLK>,
                 <&cmu_hsi2 CLK_GOUT_HSI2_PCIE_GEN3A_1_MSTR_ACLK>,
                 <&cmu_hsi2 CLK_GOUT_HSI2_PCIE_GEN3A_1_SLV_ACLK>,
                 <&cmu_hsi2 CLK_GOUT_HSI2_PCIE_GEN3A_1_DRIVER_APB_CLK>;
        clock-names = "dbi", "mstr", "slv", "apb";
        phys = <&pcie_phy>;
        phy-names = "pcie";
        reset-gpios = <&gph3 0 GPIO_ACTIVE_LOW>;
        samsung,pmu-syscon = <&pmu_system_controller 0x3ec8>;
        num-lanes = <1>;
        max-link-speed = <2>;
        bus-range = <0x00 0xff>;
        ranges = <0x82000000 0 0x60000000 0x60000000 0 0xff0000>;
        interrupt-map-mask = <0 0 0 0>;
        interrupt-map = <0 0 0 0 &gic GIC_SPI 439 IRQ_TYPE_LEVEL_HIGH>;
    };
...
```

## Documentation/devicetree/bindings/phy/google,zumapro-mipi-dphy.yaml
```yaml
# SPDX-License-Identifier: GPL-2.0-only OR BSD-2-Clause
%YAML 1.2
---
$id: http://devicetree.org/schemas/phy/google,zumapro-mipi-dphy.yaml#
$schema: http://devicetree.org/meta-schemas/core.yaml#

title: Google Tensor G4 Zumapro MIPI M4M4 D-PHY

maintainers:
  - Steffen Deusch <steffen@deusch.me>

description:
  MIPI D-PHY block used by the Zumapro DSIM display controller.  Downstream
  models these MMIO ranges as extra resources on the DSIM node; the mainline
  binding gives ownership of the PHY bias and lane/PLL register windows to the
  PHY provider instead.

properties:
  compatible:
    enum:
      - google,zumapro-mipi-dphy
      - samsung,mipi-phy-m4m4

  reg:
    minItems: 2
    maxItems: 2

  reg-names:
    items:
      - const: bias
      - const: dphy

  "#phy-cells":
    const: 1

  clocks:
    maxItems: 1

  clock-names:
    items:
      - const: ref

  samsung,sysreg:
    $ref: /schemas/types.yaml#/definitions/phandle
    description:
      Display SYSREG phandle. The PHY driver uses it to select hardware reset
      ownership and release the D-PHY master reset.

  samsung,id:
    $ref: /schemas/types.yaml#/definitions/uint32
    maximum: 1
    description: D-PHY instance index.

  power-domains:
    maxItems: 1

required:
  - compatible
  - reg
  - reg-names
  - "#phy-cells"
  - clocks
  - clock-names
  - samsung,sysreg

additionalProperties: false

examples:
  - |
    oscclk: clock-24576000 {
        compatible = "fixed-clock";
        #clock-cells = <0>;
        clock-frequency = <24576000>;
    };

    sysreg_dpub: syscon@19421000 {
        compatible = "google,zumapro-disp-sysreg", "syscon";
        reg = <0x19421000 0x10>;
    };

    phy@19460000 {
        compatible = "google,zumapro-mipi-dphy";
        reg = <0x19460000 0x100>,
              <0x19460100 0x700>;
        reg-names = "bias", "dphy";
        #phy-cells = <1>;
        clocks = <&oscclk>;
        clock-names = "ref";
        samsung,sysreg = <&sysreg_dpub>;
        samsung,id = <0>;
    };

...
```

## Documentation/devicetree/bindings/phy/google,zumapro-pcie-phy.yaml
```yaml
# SPDX-License-Identifier: GPL-2.0-only OR BSD-2-Clause
%YAML 1.2
---
$id: http://devicetree.org/schemas/phy/google,zumapro-pcie-phy.yaml#
$schema: http://devicetree.org/meta-schemas/core.yaml#

title: Google Zumapro PCIe PHY

maintainers:
  - Steffen Deusch <steffen@deusch.me>

description:
  PCIe PHY (PMA + PCS) for the root complexes of the Google Zumapro
  (Tensor G4) SoC. The single-lane GEN3A_1 instance on HSI2 serves the
  on-board WiFi controller; the two-lane PCIE_GEN3_0 (SF_PCIEPHY_X2) instance
  on HSI1 serves the modem.  The PHY is driven by an external PLL reached
  through the udbg register block and is brought out of isolation through a
  PMU PCIE_PHY_CONTROL register.

properties:
  "#phy-cells":
    const: 0

  compatible:
    enum:
      - google,zumapro-pcie-phy
      - google,zumapro-pcie-x2-phy

  reg:
    maxItems: 4

  reg-names:
    items:
      - const: pma
      - const: pcs
      - const: pll
      - const: soc

  clocks:
    items:
      - description: PHY reference clock (off the dedicated pcie_user mux)
      - description: PIPE/PAL PMA+PCS register APB clock
      - description: udbg/external-PLL register APB clock

  clock-names:
    items:
      - const: ref
      - const: apb
      - const: udbg

  power-domains:
    maxItems: 1

  samsung,pmu-syscon:
    $ref: /schemas/types.yaml#/definitions/phandle-array
    maxItems: 1
    items:
      minItems: 2
      items:
        - description: phandle to the PMU system controller
        - description: offset of the PCIE_PHY_CONTROL isolation register
    description:
      Phandle/offset pair for the PMU register that releases the PCIe PHY from
      isolation.

required:
  - "#phy-cells"
  - compatible
  - reg
  - reg-names
  - clocks
  - clock-names
  - samsung,pmu-syscon

additionalProperties: false

examples:
  - |
    #include <dt-bindings/clock/google,zumapro.h>

    pcie-phy@13160000 {
        compatible = "google,zumapro-pcie-phy";
        reg = <0x13160000 0x3000>,
              <0x13140000 0x5000>,
              <0x13150000 0xd000>,
              <0x13130000 0x5000>;
        reg-names = "pma", "pcs", "pll", "soc";
        clocks = <&cmu_hsi2 CLK_GOUT_HSI2_PCIE_GEN3A_1_PHY_REFCLK_IN>,
                 <&cmu_hsi2 CLK_GOUT_HSI2_PCIE_GEN3A_1_PIPE_PAL_APB_PCLK>,
                 <&cmu_hsi2 CLK_GOUT_HSI2_PCIE_GEN3A_1_UDBG_APB_PCLK>;
        clock-names = "ref", "apb", "udbg";
        samsung,pmu-syscon = <&pmu_system_controller 0x3ec8>;
        #phy-cells = <0>;
    };
...
```

## Documentation/devicetree/bindings/soc/samsung/google,zumapro-itmon.yaml
```yaml
# SPDX-License-Identifier: (GPL-2.0-only OR BSD-2-Clause)
%YAML 1.2
---
$id: http://devicetree.org/schemas/soc/samsung/google,zumapro-itmon.yaml#
$schema: http://devicetree.org/meta-schemas/core.yaml#

title: Google Tensor G4 interconnect transaction monitor

maintainers:
  - Steffen Deusch <steffen@deusch.me>

description:
  The interconnect transaction monitor records protocol errors and response
  timeouts in the five Zumapro NoC fabrics. Each fabric has separate monitors
  for data and configuration transactions.

properties:
  compatible:
    const: google,zumapro-itmon

  reg:
    minItems: 10
    maxItems: 10

  reg-names:
    items:
      - const: nocl1a-data
      - const: nocl1b-data
      - const: nocl2aa-data
      - const: nocl2ab-data
      - const: nocl0-data
      - const: nocl1a-config
      - const: nocl1b-config
      - const: nocl2aa-config
      - const: nocl2ab-config
      - const: nocl0-config

  interrupts:
    minItems: 10
    maxItems: 10

  interrupt-names:
    items:
      - const: nocl1a-data
      - const: nocl1b-data
      - const: nocl2aa-data
      - const: nocl2ab-data
      - const: nocl0-data
      - const: nocl1a-config
      - const: nocl1b-config
      - const: nocl2aa-config
      - const: nocl2ab-config
      - const: nocl0-config

required:
  - compatible
  - reg
  - reg-names
  - interrupts
  - interrupt-names

additionalProperties: false

examples:
  - |
    #include <dt-bindings/interrupt-controller/arm-gic.h>

    itmon@26440000 {
        compatible = "google,zumapro-itmon";
        reg = <0x26440000 0x4000>, <0x26840000 0x4000>,
              <0x26c40000 0x4000>, <0x27040000 0x4000>,
              <0x26050000 0x4000>, <0x26450000 0x4000>,
              <0x26850000 0x4000>, <0x26c50000 0x4000>,
              <0x27050000 0x4000>, <0x26060000 0x4000>;
        reg-names = "nocl1a-data", "nocl1b-data", "nocl2aa-data",
                    "nocl2ab-data", "nocl0-data", "nocl1a-config",
                    "nocl1b-config", "nocl2aa-config", "nocl2ab-config",
                    "nocl0-config";
        interrupts = <GIC_SPI 619 IRQ_TYPE_LEVEL_HIGH>,
                     <GIC_SPI 624 IRQ_TYPE_LEVEL_HIGH>,
                     <GIC_SPI 628 IRQ_TYPE_LEVEL_HIGH>,
                     <GIC_SPI 632 IRQ_TYPE_LEVEL_HIGH>,
                     <GIC_SPI 596 IRQ_TYPE_LEVEL_HIGH>,
                     <GIC_SPI 620 IRQ_TYPE_LEVEL_HIGH>,
                     <GIC_SPI 625 IRQ_TYPE_LEVEL_HIGH>,
                     <GIC_SPI 629 IRQ_TYPE_LEVEL_HIGH>,
                     <GIC_SPI 633 IRQ_TYPE_LEVEL_HIGH>,
                     <GIC_SPI 597 IRQ_TYPE_LEVEL_HIGH>;
        interrupt-names = "nocl1a-data", "nocl1b-data", "nocl2aa-data",
                          "nocl2ab-data", "nocl0-data", "nocl1a-config",
                          "nocl1b-config", "nocl2aa-config", "nocl2ab-config",
                          "nocl0-config";
    };
```
