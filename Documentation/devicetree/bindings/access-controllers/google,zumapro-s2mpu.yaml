## Documentation/devicetree/bindings/media/google,zumapro-ispfe.yaml
```yaml
# SPDX-License-Identifier: (GPL-2.0-only OR BSD-2-Clause)
%YAML 1.2
---
$id: http://devicetree.org/schemas/media/google,zumapro-ispfe.yaml#
$schema: http://devicetree.org/meta-schemas/core.yaml#

title: Google zumapro ISPFE camera receive complex

maintainers:
  - Steffen Deusch <steffen@deusch.me>

description:
  BLK_ISPFE on Google's zumapro (Tensor G4) is the camera receive path - twelve
  CSIS links with nine combo D/C-PHYs behind them, the ISPFE front end, and a
  PDMA that carries per-frame descriptors.

properties:
  compatible:
    const: google,zumapro-ispfe

  reg:
    items:
      - description: ISPFE front end
      - description: CSIS links and their D/C-PHYs
      - description: ISPFE system registers
      - description: PDMA, inside the ISPFE front end window
      - description: PDMA wrapper, inside the ISPFE front end window
      - description: |
          CMU_ISPFE. Present because the block loses its clock mux, dividers
          and Q-channel requests across a power cycle and no clock controller
          is described for it; this window goes away when one is.
      - description: |
          Stage-2 protection unit in front of System MMU S0. Present because
          these reset with the power domain into a state that blocks all DMA
          and nothing else reopens them.
      - description: Stage-2 protection unit in front of System MMU S1
      - description: Stage-2 protection unit in front of System MMU S2

  reg-names:
    items:
      - const: isp-fe
      - const: csis-link-phy
      - const: isp-fe-sysreg
      - const: pdma
      - const: pdma-wrap
      - const: cmu
      - const: s2mpu0
      - const: s2mpu1
      - const: s2mpu2

  power-domains:
    maxItems: 1

  clocks:
    maxItems: 1
    description:
      CAM ACPM DVFS domain used for ISPFE setup and steady-state operation.

  clock-names:
    items:
      - const: cam

  interconnects:
    maxItems: 1

  interconnect-names:
    items:
      - const: memory

  google,backend:
    $ref: /schemas/types.yaml#/definitions/phandle
    description:
      Camera back-end core which consumes the line-memory processor's
      compressed main-Bayer memory output.

  interrupts:
    description:
      Downstream names 202 interrupts on this block; they share 17 GIC lines,
      and all 17 are described here.
    maxItems: 17

  interrupt-names:
    items:
      - const: csis0
      - const: csis1
      - const: csis2
      - const: csis3
      - const: csis4
      - const: csis5
      - const: csis6
      - const: csis7
      - const: csis8
      - const: csis9
      - const: csis10
      - const: csis11
      - const: csis-core
      - const: fc
      - const: lmp-bayer
      - const: lmp-pdaf
      - const: pdma
  samsung,iommu-group:
    $ref: /schemas/types.yaml#/definitions/phandle
    description:
      The shared IOMMU group object. Required by the System MMU v9 driver,
      which cannot attach a device whose group it did not create.

  samsung,pmu-syscon:
    $ref: /schemas/types.yaml#/definitions/phandle-array
    items:
      - items:
          - description: phandle to the PMU system controller
          - description: offset of the D/C-PHY isolation word
    description:
      The nine D/C-PHYs share one PMU isolation bit, and while it is set their
      register region reads zero and takes no writes.

  iommus:
    items:
      - description: ISPFE System MMU S0
      - description: ISPFE System MMU S1
      - description: ISPFE System MMU S2
    description:
      All three instances, because they share one translation context - a frame
      buffer's address is invalidated in every one of them.

  ports:
    $ref: /schemas/graph.yaml#/properties/ports
    description:
      One port per CSIS link bank that has a camera on it. The port number is
      the link bank number, which is what selects the combo D/C-PHY behind it.

    patternProperties:
      "^port@([0-9]|1[01])$":
        $ref: /schemas/graph.yaml#/$defs/port-base
        unevaluatedProperties: false
        description: A CSIS link bank.

        properties:
          endpoint:
            $ref: /schemas/media/video-interfaces.yaml#
            unevaluatedProperties: false

            properties:
              data-lanes:
                minItems: 1
                maxItems: 4

            required:
              - data-lanes
              - bus-type

        required:
          - endpoint

required:
  - compatible
  - reg
  - reg-names
  - interrupts
  - interrupt-names
  - power-domains
  - clocks
  - clock-names
  - interconnects
  - interconnect-names
  - iommus
  - samsung,iommu-group
  - samsung,pmu-syscon
  - google,backend
  - ports

additionalProperties: false

examples:
  - |
    #include <dt-bindings/clock/google,zumapro-acpm.h>
    #include <dt-bindings/interrupt-controller/arm-gic.h>
    #include <dt-bindings/interconnect/google,zumapro.h>
    #include <dt-bindings/media/video-interfaces.h>

    camera@1c300000 {
        compatible = "google,zumapro-ispfe";
        reg = <0x1c300000 0x100000>,
              <0x1c040000 0xd0000>,
              <0x1c020000 0x10000>,
              <0x1c390000 0x5000>,
              <0x1c395000 0x1000>,
              <0x1c000000 0x8000>,
              <0x1c140000 0x10000>,
              <0x1c180000 0x10000>,
              <0x1c1c0000 0x10000>;
        reg-names = "isp-fe", "csis-link-phy", "isp-fe-sysreg",
                    "pdma", "pdma-wrap", "cmu",
                    "s2mpu0", "s2mpu1", "s2mpu2";
        power-domains = <&pd_ispfe>;
        clocks = <&acpm_ipc ZUMAPRO_CLK_ACPM_DVFS_CAM>;
        clock-names = "cam";
        interconnects = <&bts ZUMAPRO_BTS_MASTER_ISPFE>,
                        <&bts ZUMAPRO_BTS_SLAVE_MIF>;
        interconnect-names = "memory";
        google,backend = <&becore>;
        iommus = <&sysmmu_ispfe_s0>, <&sysmmu_ispfe_s1>, <&sysmmu_ispfe_s2>;
        interrupts = <GIC_SPI 467 IRQ_TYPE_LEVEL_HIGH 0>,
                     <GIC_SPI 468 IRQ_TYPE_LEVEL_HIGH 0>,
                     <GIC_SPI 469 IRQ_TYPE_LEVEL_HIGH 0>,
                     <GIC_SPI 470 IRQ_TYPE_LEVEL_HIGH 0>,
                     <GIC_SPI 471 IRQ_TYPE_LEVEL_HIGH 0>,
                     <GIC_SPI 472 IRQ_TYPE_LEVEL_HIGH 0>,
                     <GIC_SPI 473 IRQ_TYPE_LEVEL_HIGH 0>,
                     <GIC_SPI 474 IRQ_TYPE_LEVEL_HIGH 0>,
                     <GIC_SPI 475 IRQ_TYPE_LEVEL_HIGH 0>,
                     <GIC_SPI 476 IRQ_TYPE_LEVEL_HIGH 0>,
                     <GIC_SPI 477 IRQ_TYPE_LEVEL_HIGH 0>,
                     <GIC_SPI 478 IRQ_TYPE_LEVEL_HIGH 0>,
                     <GIC_SPI 479 IRQ_TYPE_LEVEL_HIGH 0>,
                     <GIC_SPI 480 IRQ_TYPE_LEVEL_HIGH 0>,
                     <GIC_SPI 481 IRQ_TYPE_LEVEL_HIGH 0>,
                     <GIC_SPI 482 IRQ_TYPE_LEVEL_HIGH 0>,
                     <GIC_SPI 483 IRQ_TYPE_LEVEL_HIGH 0>;
        interrupt-names = "csis0", "csis1", "csis2", "csis3",
                          "csis4", "csis5", "csis6", "csis7",
                          "csis8", "csis9", "csis10", "csis11",
                          "csis-core", "fc", "lmp-bayer",
                          "lmp-pdaf", "pdma";
        samsung,iommu-group = <&iommu_group_isp>;
        samsung,pmu-syscon = <&pmu_system_controller 0x3ebc>;

        ports {
            #address-cells = <1>;
            #size-cells = <0>;

            port@1 {
                reg = <1>;

                ispfe_in: endpoint {
                    remote-endpoint = <&sensor_out>;
                    bus-type = <MEDIA_BUS_TYPE_CSI2_DPHY>;
                    data-lanes = <1 2 3 4>;
                };
            };
        };
    };
```

## Documentation/devicetree/bindings/media/i2c/onnn,lc898129.yaml
```yaml
# SPDX-License-Identifier: (GPL-2.0-only OR BSD-2-Clause)
%YAML 1.2
---
$id: http://devicetree.org/schemas/media/i2c/onnn,lc898129.yaml#
$schema: http://devicetree.org/meta-schemas/core.yaml#

title: ON Semiconductor LC898129 lens voice coil actuator

maintainers:
  - Steffen Deusch <steffen@deusch.me>

description: |
  The LC898129 is an OIS and closed-loop AF control LSI: one I2C address
  carrying the camera module's focus actuator, its optical stabiliser and its
  EEPROM. This binding describes the focus actuator alone.

  The part has no supply of its own to describe. It is powered by the rails of
  the camera module it is built into, and comes up with that module's image
  sensor, so it answers on I2C exactly when the sensor does. Where a device
  tree needs to express that ordering it does so on the sensor's node, which is
  where the module's power sequence belongs; this node names the actuator so
  that the sensor's lens-focus property has something to point at.

properties:
  compatible:
    const: onnn,lc898129

  reg:
    maxItems: 1

required:
  - compatible
  - reg

additionalProperties: false

examples:
  - |
    i2c {
        #address-cells = <1>;
        #size-cells = <0>;

        focus@24 {
            compatible = "onnn,lc898129";
            reg = <0x24>;
        };
    };
...
```

## Documentation/devicetree/bindings/media/i2c/samsung,s5kgn8.yaml
```yaml
# SPDX-License-Identifier: (GPL-2.0-only OR BSD-2-Clause)
%YAML 1.2
---
$id: http://devicetree.org/schemas/media/i2c/samsung,s5kgn8.yaml#
$schema: http://devicetree.org/meta-schemas/core.yaml#

title: Samsung S5KGN8 CMOS Digital Image Sensor

maintainers:
  - Steffen Deusch <steffen@deusch.me>

description:
  The S5KGN8 is a Samsung ISOCELL CMOS active pixel digital image sensor. It is
  programmed over I2C with 16-bit register addresses and 16-bit values through a
  paged register file, and sends image data over three MIPI CSI-2 C-PHY data
  lanes. The mode this driver programs reads the array out 2x2 binned.

allOf:
  - $ref: /schemas/media/video-interface-devices.yaml#

properties:
  compatible:
    const: samsung,s5kgn8

  reg:
    maxItems: 1

  clocks:
    description: EXTCLK, the sensor master clock
    maxItems: 1

  reset-gpios:
    description: Asserted low to hold the sensor in reset
    maxItems: 1

  pinctrl-names:
    items:
      - const: default
      - const: sleep
    description:
      The master clock pad is muxed to its clock function in the default state
      and parked in the sleep state, so that it is only driven while the sensor
      is powered.

  iovdd-supply:
    description: Interface power supply (1.8V)

  avdd-supply:
    description: First analog power supply

  avdd2-supply:
    description: Second analog power supply

  avdd3-supply:
    description: Third analog power supply

  dvdd-supply:
    description: Digital power supply

  port:
    additionalProperties: false
    $ref: /schemas/graph.yaml#/$defs/port-base

    properties:
      endpoint:
        $ref: /schemas/media/video-interfaces.yaml#
        unevaluatedProperties: false

        properties:
          data-lanes:
            minItems: 3
            maxItems: 3

        required:
          - data-lanes

    required:
      - endpoint

required:
  - compatible
  - reg
  - clocks
  - reset-gpios
  - iovdd-supply
  - avdd-supply
  - avdd2-supply
  - avdd3-supply
  - dvdd-supply
  - port

unevaluatedProperties: false

examples:
  - |
    #include <dt-bindings/gpio/gpio.h>

    i2c {
        #address-cells = <1>;
        #size-cells = <0>;

        camera@56 {
            compatible = "samsung,s5kgn8";
            reg = <0x56>;

            clocks = <&s5kgn8_clk>;

            iovdd-supply = <&camera_vddio_1v8>;
            avdd-supply = <&camera_vdda_2v9_b>;
            avdd2-supply = <&camera_vdda_2v9_a>;
            avdd3-supply = <&camera_vdda_2v25>;
            dvdd-supply = <&camera_vddd>;

            reset-gpios = <&gpio 2 GPIO_ACTIVE_LOW>;

            orientation = <1>;
            rotation = <270>;

            port {
                s5kgn8_output: endpoint {
                    bus-type = <1>; /* MIPI CSI-2 C-PHY */
                    data-lanes = <1 2 3>;
                    remote-endpoint = <&csi_input>;
                };
            };
        };
    };
...
```

## Documentation/devicetree/bindings/media/i2c/sony,imx712.yaml
```yaml
# SPDX-License-Identifier: (GPL-2.0-only OR BSD-2-Clause)
%YAML 1.2
---
$id: http://devicetree.org/schemas/media/i2c/sony,imx712.yaml#
$schema: http://devicetree.org/meta-schemas/core.yaml#

title: Sony IMX712 CMOS Digital Image Sensor

maintainers:
  - Steffen Deusch <steffen@deusch.me>

description:
  The IMX712 is a Sony CMOS active pixel digital image sensor with a
  4208H x 3120V active array. It is programmed over I2C with 16-bit register
  addresses and 8-bit values, and sends image data over four MIPI CSI-2 D-PHY
  data lanes.

allOf:
  - $ref: /schemas/media/video-interface-devices.yaml#

properties:
  compatible:
    const: sony,imx712

  reg:
    maxItems: 1

  clocks:
    description: EXTCLK, the sensor master clock
    maxItems: 1

  reset-gpios:
    description: XCLR, asserted low to hold the sensor in reset
    maxItems: 1

  pinctrl-names:
    items:
      - const: default
      - const: sleep
    description:
      The master clock pad is muxed to its clock function in the default state
      and parked in the sleep state, so that it is only driven while the sensor
      is powered.

  iovdd-supply:
    description: Interface power supply (1.8V)

  avdd-supply:
    description: Analog power supply (2.8V)

  dvdd-supply:
    description: Digital power supply (1.2V)

  port:
    additionalProperties: false
    $ref: /schemas/graph.yaml#/$defs/port-base

    properties:
      endpoint:
        $ref: /schemas/media/video-interfaces.yaml#
        unevaluatedProperties: false

        properties:
          data-lanes:
            minItems: 4
            maxItems: 4

        required:
          - data-lanes
          - link-frequencies

    required:
      - endpoint

required:
  - compatible
  - reg
  - clocks
  - reset-gpios
  - iovdd-supply
  - avdd-supply
  - dvdd-supply
  - port

unevaluatedProperties: false

examples:
  - |
    #include <dt-bindings/gpio/gpio.h>

    i2c {
        #address-cells = <1>;
        #size-cells = <0>;

        camera@1a {
            compatible = "sony,imx712";
            reg = <0x1a>;

            clocks = <&imx712_clk>;

            iovdd-supply = <&camera_vddio_1v8>;
            avdd-supply = <&camera_vdda_2v8>;
            dvdd-supply = <&camera_vddd_1v2>;

            reset-gpios = <&gpio 2 GPIO_ACTIVE_LOW>;

            orientation = <1>;

            port {
                imx712_output: endpoint {
                    data-lanes = <1 2 3 4>;
                    link-frequencies = /bits/ 64 <552960000>;
                    remote-endpoint = <&csi_input>;
                };
            };
        };
    };
...
```
